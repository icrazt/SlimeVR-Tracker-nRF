## boards/sorakage/cheesecake_nrf_prototype/board.yml
```yaml
board:
  name: cheesecake_nrf_prototype
  vendor: sorakage
  socs:
    - name: nrf52840
```

## boards/sorakage/cheesecake_nrf_prototype/cheesecake_nrf_prototype_defconfig
```kconfig
CONFIG_ARM_MPU=y
CONFIG_HW_STACK_PROTECTION=y

# Enable RTT
CONFIG_USE_SEGGER_RTT=y

# enable GPIO
CONFIG_GPIO=y

# enable uart driver
CONFIG_SERIAL=y

# enable console
CONFIG_CONSOLE=y
CONFIG_UART_CONSOLE=y
CONFIG_USB_DEVICE_STACK=y
CONFIG_USB_DEVICE_MANUFACTURER="SlimeVR"
CONFIG_USB_DEVICE_PRODUCT="SlimeNRF Tracker SK"

CONFIG_BATTERY_USE_REG_BUCK_MAPPING=y
CONFIG_LED_RGB_COLOR=y
CONFIG_BUILD_OUTPUT_UF2=y
```
